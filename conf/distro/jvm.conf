## conf/distro/jvm.conf
```bitbake
require conf/distro/poky.conf
include conf/distro/include/jvm-versions.inc

DISTRO = "jvm"
DISTRO_NAME = "JVM Distro"
DISTRO_VERSION = "0.1"

DISTRO_FEATURES += "\
    systemd \
    usrmerge \
    networkd \
"

DISTRO_FEATURES_BACKFILL_CONSIDERED += "sysvinit"

INITRAMFS_IMAGE = "core-image-minimal-initramfs"
INITRAMFS_IMAGE_BUNDLE:x86-64 = "1"

INIT_MANAGER = "systemd"
VIRTUAL-RUNTIME_init_manager = "systemd"
VIRTUAL-RUNTIME_initscripts = ""
VIRTUAL-RUNTIME_syslog = ""

SERIAL_CONSOLES = "115200;ttyS0"

IMAGE_FSTYPES = "ext4 ext4.gz wic wic.gz wic.bmap"

WKS_FILE = "efi-disk.wks"
WKS_FILE_DEPENDS ?= "grub-efi"
WIC_CREATE_EXTRA_ARGS ?= "--no-fstab-update"
WIC_CREATE_EXTRA_ARGS += "\
    --rootfs-dir rootfs-main=${IMAGE_ROOTFS} \
    "
```

## conf/layer.conf
```bitbake
# We have a conf and classes directory, add to BBPATH
BBPATH .= ":${LAYERDIR}"

# We have a packages directory, add to BBFILES
BBFILES += "${LAYERDIR}/recipes-*/*/*.bb \
            ${LAYERDIR}/recipes-*/*/*.bbappend"

BBFILE_COLLECTIONS += "jvm"
BBFILE_PATTERN_jvm = "^${LAYERDIR}/"
BBFILE_PRIORITY_jvm = "10"

# Most dependencies come from the meta-python layer
LAYERDEPENDS_jvm = "\
    core \
    openembedded-layer \
    networking-layer \
"

PREFERRED_PROVIDER_virtual/kernel = "linux-yocto-rt"

LAYERSERIES_COMPAT_jvm = "gatesgarth hardknott honister kirkstone langdale mickledore nanbield scarthgap styhead walnascar "
```

## wic/efi-disk.wks
```
# short-description: Create an EFI disk image

part /boot --source bootimg-efi --sourceparams="loader=grub-efi" --label boot --active --align 1024 --use-uuid
part / --source rootfs --rootfs-dir=rootfs-main --fstype=ext4 --label root --align 1024 --use-uuid
part swap --size 44 --label swap --fstype=swap --use-uuid
```
